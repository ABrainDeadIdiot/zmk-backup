## config/boards/shields/TubeTest/Kconfig.defconfig
```kconfig
if SHIELD_TUBETEST_LEFT

config ZMK_KEYBOARD_NAME
    default "split"

config ZMK_SPLIT_ROLE_CENTRAL
    default y

endif

if SHIELD_TUBETEST_LEFT || SHIELD_TUBETEST_RIGHT

config ZMK_SPLIT
    default y

endif
```

## config/boards/shields/TubeTest/Kconfig.shield
```kconfig
config SHIELD_TUBETEST_LEFT
    def_bool $(shields_list_contains,TubeTest_left)
  
config SHIELD_TUBETEST_RIGHT
    def_bool $(shields_list_contains,TubeTest_right)
  
```
